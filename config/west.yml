## config/west.yml
```yaml
manifest:
  remotes:
    - name: Gorbataras
      url-base: https://github.com/Gorbataras
    - name: zmkfirmware
      url-base: https://github.com/zmkfirmware
  projects:
    - name: zmk
      remote: zmkfirmware
      revision: main
      import: app/west.yml
  self:
    path: config
```
